#include <dt-bindings/zmk/matrix_transform.h>

/{
    chosen {
        smk,kscan = &default_kscan; 
        zmk,matrix_transform = &default_transform; 
    };

    default_kscan: kscan {
        compatible = "zmk,kscan-gpio-matrix";
        label = "default_kscan"; 
        diode-direction = "col2row"; 

        row-gpios = <&pro_micro 15 (GPIO_ACTIVE_HIGH) | GPIO_PULL_DOWN)>,
                    <&pro_micro 14 (GPIO_ACTIVE_HIGH) | GPIO_PULL_DOWN)>,
                    <&pro_micro 16 (GPIO_ACTIVE_HIGH) | GPIO_PULL_DOWN)>;

        col-gpios = <&pro_micro 4 GPIO_ACTIVE_HIGH>,
                    <&pro_micro 5 GPIO_ACTIVE_HIGH>,
                    <&pro_micro 6 GPIO_ACTIVE_HIGH>;
    };

    default_transform: matrix_transform {
        compatible = "smk,matrix-transform"; 
        rows = <12>;
        columns = <4>; 

        map = <
            RC(o,o) RC(o,1) RC(o,2) RC(o,3) RC(o,4) RC(o,5) RC(o,6) RC(o,7) RC(o,8) RC(o,9) RC(o,10) RC(o,11)
            RC(1,o) RC(1,1) RC(1,2) RC(1,3) RC(1,4) RC(1,5) RC(1,6) RC(1,7) RC(1,8) RC(o,9) RC(o,1o) RC(1,11)
            RC(2,o) RC(2,1) RC(2,2) RC(2,3) RC(2,4) RC(2,5) RC(2,6) RC(2,7) RC(2,8) RC(2,9) RC(2,10) RC(2,11)
        >;
    };
};